## dts/bindings/radio_coex/nordic,nrf-coexc-ipc.yaml
```yaml
# Copyright (c) 2026 Nordic Semiconductor ASA
# SPDX-License-Identifier: LicenseRef-Nordic-5-Clause

description: |
  COEXC (Coexistence Controller) IPC interface for the short-range radio subsystem.

  The COEXC peripheral arbitrates RF access between Wi-Fi, short-range radios,
  and external devices. Short-range radio clients communicate with COEXC
  exclusively via IPCT. Each client is associated with two IPCT channels: one
  for REQUEST (asserted by the radio) / GRANT (asserted by COEXC), and one for
  RELEASE (asserted by the radio) / REVOKE (asserted by COEXC). REQUEST/GRANT
  and RELEASE/REVOKE share the same channel index in each pair.

  Two clients are allocated to the short-range radio: one for RX operations and
  one for TX operations. tx-channels and rx-channels each carry the channel
  indices for the respective operation as <request-channel release-channel>.

compatible: "nordic,nrf-coexc-ipc"

include: base.yaml

properties:
  nordic,ipct:
    type: phandle
    required: true
    description: |
      Phandle to the COEXC interface IPCT peripheral instance.

  nordic,ipct-irq-index:
    type: int
    default: 0
    description: |
      Index into the referenced IPCT node's `interrupts` property identifying
      the interrupt line.

  rx-channels:
    type: array
    required: true
    description: |
      IPCT channel indices for the short-range RX radio client, as
      <request-channel release-channel>. The radio asserts the request channel
      to REQUEST an RX operation and receives GRANT on the same channel; it
      asserts the release channel to RELEASE and receives REVOKE on it.

  tx-channels:
    type: array
    required: true
    description: |
      IPCT channel indices for the short-range TX radio client, as
      <request-channel release-channel>. The radio asserts the request channel
      to REQUEST a TX operation and receives GRANT on the same channel; it
      asserts the release channel to RELEASE and receives REVOKE on it.
```

## subsys/bluetooth/services/ras/Kconfig.ras
```kconfig
#
# Copyright (c) 2024 Nordic Semiconductor ASA
#
# SPDX-License-Identifier: LicenseRef-Nordic-5-Clause
#

menuconfig BT_RAS
	bool "Enable GATT ranging service"
	select EXPERIMENTAL
	select BT_NRF_SERVICES

if BT_RAS

module = BT_RAS
module-str = RAS
source "${ZEPHYR_BASE}/subsys/logging/Kconfig.template.log_config"

endif # BT_RAS
```

## subsys/bluetooth/services/ras/rreq/Kconfig.ras_rreq
```kconfig
#
# Copyright (c) 2024 Nordic Semiconductor ASA
#
# SPDX-License-Identifier: LicenseRef-Nordic-5-Clause
#

menuconfig BT_RAS_RREQ
	bool "Enable GATT Ranging Requester Client [EXPERIMENTAL]"
	depends on BT_CHANNEL_SOUNDING
	select EXPERIMENTAL
	select BT_NRF_SERVICES
	select BT_RAS

if BT_RAS_RREQ

module = BT_RAS_RREQ
module-str = RAS_RREQ
source "${ZEPHYR_BASE}/subsys/logging/Kconfig.template.log_config"

config BT_RAS_RREQ_MAX_ACTIVE_CONN
	int "Number of simultaneously supported RREQ instances"
	default BT_MAX_CONN
	range 1 BT_MAX_CONN
	help
	  The number of simultaneous connections with an instance of RAS RREQ

endif # BT_RAS_RREQ
```
